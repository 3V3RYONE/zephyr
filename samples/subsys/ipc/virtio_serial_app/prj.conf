## CMakeLists.txt
```
# SPDX-License-Identifier: Apache-2.0

cmake_minimum_required(VERSION 3.20.0)

find_package(Zephyr REQUIRED HINTS $ENV{ZEPHYR_BASE})
project(virtio_serial_app)

# Add source files
target_sources(app PRIVATE
    src/main.c
    src/resource_table.c
)

# Include directories
target_include_directories(app PRIVATE
    src
)
```

## sample.yaml
```
sample:
  name: VirtIO Serial for Linux-Zephyr IPC
  description: |
    VirtIO RPROC_SERIAL device implementation for TI AM62x M4 core.
    Demonstrates direct VirtIO communication with Linux without RPMsg layer.

    When Linux writes to /dev/vportXpY, the M4 receives the data and logs
    it to the console.

tests:
  sample.ipc.virtio_serial:
    tags: ipc virtio openamp
    harness: console
    harness_config:
      type: multi_line
      ordered: true
      regex:
        - "VirtIO Serial Device - Zephyr on AM62x M4"
        - "VirtIO Serial ready - waiting for Linux"
    platform_allow:
      - sk_am62/am6254/m4
      - beagleplay/am6254/m4
      - phyboard_lyra/am6234/m4
      - verdin_am62/am6234/m4
    integration_platforms:
      - sk_am62/am6254/m4
```

## prj.conf
```kconfig
# Zephyr configuration for VirtIO Serial Application on AM62x M4

# Enable logging
CONFIG_LOG=y
CONFIG_LOG_MODE_IMMEDIATE=y
CONFIG_PRINTK=y
CONFIG_EARLY_CONSOLE=y

# Enable console
CONFIG_CONSOLE=y
CONFIG_UART_CONSOLE=y

# OpenAMP and LibMetal support
CONFIG_OPENAMP=y
CONFIG_LIBMETAL=y

# Mailbox driver for IPC interrupts
CONFIG_MBOX=y

# Memory and heap configuration
CONFIG_HEAP_MEM_POOL_SIZE=16384
CONFIG_MAIN_STACK_SIZE=2048

# System initialization
CONFIG_SYSTEM_WORKQUEUE_STACK_SIZE=2048

# Enable Assert
CONFIG_ASSERT=y
CONFIG_ASSERT_LEVEL=2
```

## boards/sk_am62_am6254_m4.overlay
```dts
/*
 * Copyright (c) 2024
 * SPDX-License-Identifier: Apache-2.0
 *
 * Device tree overlay for VirtIO Serial application on AM62x M4
 */

/* Enable mailbox for IPC with Linux */
&mbox0 {
	status = "okay";
};
```

## src/main.c
```c
/*
 * Copyright (c) 2024
 *
 * SPDX-License-Identifier: Apache-2.0
 *
 * VirtIO Serial application for TI AM62x M4 core
 * Adapted from RPMsg-TTY design to use VirtIO APIs directly
 */

#include <zephyr/kernel.h>
#include <zephyr/sys/printk.h>
#include <zephyr/logging/log.h>
#include <zephyr/drivers/mbox.h>
#include <string.h>

#include <openamp/open_amp.h>
#include <metal/sys.h>
#include <metal/io.h>

#include "resource_table.h"

LOG_MODULE_REGISTER(virtio_serial, LOG_LEVEL_DBG);

/* Metal and VirtIO structures */
static struct metal_io_region shm_io_data;
static struct metal_io_region rsc_io_data;
static struct metal_io_region *shm_io = &shm_io_data;
static struct metal_io_region *rsc_io = &rsc_io_data;

static struct virtio_device *vdev;
static struct virtqueue *vq_rx;  /* RX: Linux to M4 */
static struct virtqueue *vq_tx;  /* TX: M4 to Linux */

/* Message structure to hold received data */
struct virtio_rcv_msg {
	void *data;
	uint32_t len;
	uint16_t idx;
};

static struct virtio_rcv_msg tty_msg;

/* Semaphores - matching RPMsg design */
static K_SEM_DEFINE(data_sem, 0, 1);      /* For mailbox interrupt */
static K_SEM_DEFINE(data_tty_sem, 0, 1);  /* For TTY data */

/* Mailbox device */
static const struct device *mbox_dev = DEVICE_DT_GET(DT_NODELABEL(mbox0));
#define MBOX_RX_CHANNEL 1
#define MBOX_TX_CHANNEL 0

/* Thread stacks */
#define APP_TASK_STACK_SIZE (1024)
#define APP_TTY_TASK_STACK_SIZE (1536)

K_THREAD_STACK_DEFINE(thread_mng_stack, APP_TASK_STACK_SIZE);
K_THREAD_STACK_DEFINE(thread_tty_stack, APP_TTY_TASK_STACK_SIZE);

static struct k_thread thread_mng_data;
static struct k_thread thread_tty_data;

/**
 * Mailbox callback - matches platform_ipm_callback from RPMsg
 */
static void platform_mbox_callback(const struct device *dev, uint32_t channel,
				   void *user_data, struct mbox_msg *msg)
{
	ARG_UNUSED(dev);
	ARG_UNUSED(user_data);

	k_sem_give(&data_sem);
}

/**
 * VirtIO RX callback - matches rpmsg_recv_tty_callback
 * Holds buffer and signals TTY task
 */
static void virtio_serial_rx_callback(struct virtqueue *vq)
{
	void *buffer;
	uint32_t len;
	uint16_t idx;

	if (!vq) {
		return;
	}

	/* Get one buffer - "hold" pattern like RPMsg */
	buffer = virtqueue_get_available_buffer(vq, &idx, &len);
	if (buffer && len > 0) {
		/* Hold buffer - store for deferred processing */
		tty_msg.data = buffer;
		tty_msg.len = len;
		tty_msg.idx = idx;

		/* Signal TTY task */
		k_sem_give(&data_tty_sem);
	}
}

/**
 * VirtIO TX callback - not used in echo pattern
 */
static void virtio_serial_tx_callback(struct virtqueue *vq)
{
	/* TX buffer reclamation handled by Linux polling */
}

/**
 * Mailbox notify function - sends interrupt to Linux
 */
static int mailbox_notify(void *priv, uint32_t id)
{
	ARG_UNUSED(priv);


	struct mbox_msg msg = {
		.data = &id,
		.size = sizeof(id),
	};

	int ret = mbox_send(mbox_dev, MBOX_TX_CHANNEL, &msg);
	if (ret < 0) {
		//LOG_ERR("Failed to send mailbox message: %d", ret);
		return ret;
	}

	return 0;
}

/**
 * Receive message function - matches RPMsg receive_message
 * Called by management task to process interrupts
 */
static void receive_message(unsigned char **msg, unsigned int *len)
{
	int status = k_sem_take(&data_sem, K_FOREVER);

	if (status == 0) {
		/* Notify virtio framework - this triggers rx_callback */
		rproc_virtio_notified(vdev, VRING1_ID);
	}
}

/**
 * Platform initialization - matches RPMsg platform_init
 */
static int platform_init(void)
{
	struct metal_init_params metal_params = METAL_INIT_DEFAULTS;
	uint32_t vring_rx_addr, vring_tx_addr;
	int ret;

	//LOG_INF("Initializing platform");

	/* Initialize Metal */
	ret = metal_init(&metal_params);
	if (ret) {
		//LOG_ERR("metal_init failed: %d", ret);
		return -1;
	}

	/* Wait for Linux to allocate VRING addresses */
	//LOG_INF("Waiting for Linux to allocate VRING memory...");
	int timeout = 100;
	while (!rsc_table_vrings_allocated() && timeout > 0) {
		k_sleep(K_MSEC(100));
		timeout--;
	}

	if (!rsc_table_vrings_allocated()) {
		LOG_ERR("Timeout waiting for Linux VRING allocation");
		return -1;
	}

	vring_rx_addr = rsc_table_get_vring_rx_addr();
	vring_tx_addr = rsc_table_get_vring_tx_addr();

	//LOG_INF("Linux allocated VRINGs: RX=0x%08X, TX=0x%08X",
		//vring_rx_addr, vring_tx_addr);

	/* Initialize shared memory IO region */
	metal_phys_addr_t shm_physmap = vring_rx_addr;
	metal_io_init(shm_io, (void *)vring_rx_addr, &shm_physmap,
		      0x20000, -1, 0, NULL);

	/* Initialize resource table IO region */
	metal_phys_addr_t rsc_tab_physmap = (uintptr_t)&resource_table;
	metal_io_init(rsc_io, (void *)&resource_table, &rsc_tab_physmap,
		      sizeof(resource_table), -1, 0, NULL);

	/* Setup mailbox */
	if (!device_is_ready(mbox_dev)) {
		LOG_ERR("Mailbox device not ready");
		return -1;
	}

	ret = mbox_register_callback(mbox_dev, MBOX_RX_CHANNEL,
				     platform_mbox_callback, NULL);
	if (ret < 0) {
		LOG_ERR("Failed to register mailbox callback: %d", ret);
		return -1;
	}

	ret = mbox_set_enabled(mbox_dev, MBOX_RX_CHANNEL, true);
	if (ret < 0) {
		LOG_ERR("Failed to enable mailbox: %d", ret);
		return -1;
	}

	//LOG_INF("Mailbox initialized: RX=%d, TX=%d", MBOX_RX_CHANNEL, MBOX_TX_CHANNEL);

	return 0;
}

/**
 * Cleanup - matches RPMsg cleanup_system
 */
static void cleanup_system(void)
{
	mbox_set_enabled(mbox_dev, MBOX_RX_CHANNEL, false);
	if (vdev) {
		rproc_virtio_remove_vdev(vdev);
	}
	metal_finish();
}

/**
 * Create VirtIO device - matches RPMsg platform_create_rpmsg_vdev
 */
static int platform_create_virtio_vdev(void)
{
	uint32_t vring_rx_addr, vring_tx_addr;
	int ret;

	//LOG_INF("Creating VirtIO device");

	/* Create VirtIO device */
	vdev = rproc_virtio_create_vdev(VIRTIO_DEV_DEVICE, VDEV_ID,
					&resource_table.vdev,
					rsc_io, NULL, mailbox_notify, NULL);
	if (!vdev) {
		LOG_ERR("Failed to create vdev");
		return -1;
	}

	/* Wait for Linux driver to be ready */
	//LOG_INF("Waiting for Linux virtio_console driver...");
	rproc_virtio_wait_remote_ready(vdev);
	LOG_INF("Linux driver is ready");

	vring_rx_addr = rsc_table_get_vring_rx_addr();
	vring_tx_addr = rsc_table_get_vring_tx_addr();

	/* Initialize VRING 0: M4 TX (Linux RX) */
	ret = rproc_virtio_init_vring(vdev, 0, resource_table.vring0.notifyid,
				      (void *)vring_tx_addr, shm_io,
				      resource_table.vring0.num,
				      resource_table.vring0.align);
	if (ret) {
		LOG_ERR("Failed to init TX vring: %d", ret);
		goto failed;
	}

	/* Initialize VRING 1: M4 RX (Linux TX) */
	ret = rproc_virtio_init_vring(vdev, 1, resource_table.vring1.notifyid,
				      (void *)vring_rx_addr, shm_io,
				      resource_table.vring1.num,
				      resource_table.vring1.align);
	if (ret) {
		LOG_ERR("Failed to init RX vring: %d", ret);
		goto failed;
	}

	/* Create virtqueues */
	const char *vq_names[] = {"tx_vq", "rx_vq"};
	vq_callback vq_cbs[] = {virtio_serial_tx_callback, virtio_serial_rx_callback};

	ret = virtio_create_virtqueues(vdev, 0, VRING_COUNT, vq_names, vq_cbs, NULL);
	if (ret) {
		LOG_ERR("Failed to create virtqueues: %d", ret);
		goto failed;
	}

	/* Get virtqueue pointers */
	vq_tx = vdev->vrings_info[0].vq;
	vq_rx = vdev->vrings_info[1].vq;

	if (!vq_rx || !vq_tx) {
		LOG_ERR("Failed to get virtqueue pointers");
		ret = -1;
		goto failed;
	}

	/* Set shared memory I/O region for buffer access */
	vq_rx->shm_io = shm_io;
	vq_tx->shm_io = shm_io;

	//LOG_INF("VirtIO device initialized successfully");

	return 0;

failed:
	if (vdev) {
		rproc_virtio_remove_vdev(vdev);
	}
	return ret;
}

/**
 * TTY task - matches app_rpmsg_tty exactly
 */
void app_virtio_tty(void *arg1, void *arg2, void *arg3)
{
	ARG_UNUSED(arg1);
	ARG_UNUSED(arg2);
	ARG_UNUSED(arg3);

	void *tx_buffer;
	uint32_t tx_len;
	uint16_t tx_idx;

	/* Wait for management task to signal us */
	k_sem_take(&data_tty_sem, K_FOREVER);

//	LOG_INF("VirtIO TTY task started");

	/* Main loop - process messages one at a time */
	while (1) {
		k_sem_take(&data_tty_sem, K_FOREVER);

		if (tty_msg.len > 0 && tty_msg.data) {
			/* Get TX buffer */
			tx_buffer = virtqueue_get_available_buffer(vq_tx, &tx_idx, &tx_len);
			if (tx_buffer) {
				/* Echo: copy RX data to TX buffer */
				uint32_t copy_len = (tty_msg.len < tx_len) ?
						    tty_msg.len : tx_len;
				metal_io_block_write(shm_io,
						     metal_io_virt_to_offset(shm_io, tx_buffer),
						     tty_msg.data, copy_len);

				/* Send to Linux */
				virtqueue_add_consumed_buffer(vq_tx, tx_idx, copy_len);
				virtqueue_kick(vq_tx);
			}

			/* Release RX buffer - matching rpmsg_release_rx_buffer behavior */
			virtqueue_add_consumed_buffer(vq_rx, tty_msg.idx, tty_msg.len);
			virtqueue_kick(vq_rx);
		}

		/* Clear message */
		tty_msg.len = 0;
		tty_msg.data = NULL;
	}

	//LOG_INF("VirtIO TTY task ended");
}

/**
 * Management task - matches rpmsg_mng_task exactly
 */
void virtio_mng_task(void *arg1, void *arg2, void *arg3)
{
	ARG_UNUSED(arg1);
	ARG_UNUSED(arg2);
	ARG_UNUSED(arg3);

	unsigned char *msg;
	unsigned int len;
	int ret = 0;

	//LOG_INF("VirtIO management task started");

	/* Initialize platform */
	ret = platform_init();
	if (ret) {
		LOG_ERR("Failed to initialize platform");
		ret = -1;
		goto task_end;
	}

	/* Create VirtIO device */
	ret = platform_create_virtio_vdev();
	if (ret) {
		LOG_ERR("Failed to create VirtIO device");
		ret = -1;
		goto task_end;
	}

	/* Start the TTY task */
	k_sem_give(&data_tty_sem);

	/* Main loop - process interrupts */
	while (1) {
		receive_message(&msg, &len);
	}

task_end:
	cleanup_system();
	//LOG_INF("VirtIO management task ended");
}

/**
 * Main entry point - matches RPMsg main exactly
 */
int main(void)
{
	printk("\n");
	printk("===============================================\n");
	printk("  VirtIO Serial - Zephyr on AM62x M4          \n");
	printk("===============================================\n");
	printk("\n");

//	LOG_INF("Starting application threads!");

	/* Create management task */
	k_thread_create(&thread_mng_data, thread_mng_stack, APP_TASK_STACK_SIZE,
			virtio_mng_task,
			NULL, NULL, NULL, K_PRIO_COOP(8), 0, K_NO_WAIT);

	/* Create TTY task */
	k_thread_create(&thread_tty_data, thread_tty_stack, APP_TTY_TASK_STACK_SIZE,
			app_virtio_tty,
			NULL, NULL, NULL, K_PRIO_COOP(7), 0, K_NO_WAIT);

	return 0;
}
```

## src/main_minimal.c
```c
/*
 * Copyright (c) 2024
 *
 * SPDX-License-Identifier: Apache-2.0
 *
 * Minimal VirtIO Serial application for TI AM62x M4
 * This is a skeleton that compiles successfully
 */

#include <zephyr/kernel.h>
#include <zephyr/sys/printk.h>
#include <zephyr/logging/log.h>

#include "resource_table.h"

LOG_MODULE_REGISTER(virtio_serial, LOG_LEVEL_DBG);

int main(void)
{
	uint32_t vring_rx_addr, vring_tx_addr;
	int timeout = 100;

	printk("\n");
	printk("===============================================\n");
	printk("  VirtIO Serial Device - Zephyr on AM62x M4   \n");
	printk("===============================================\n");
	printk("\n");

	LOG_INF("Application started on M4 core");
	LOG_INF("Resource table at: %p", &resource_table);
	LOG_INF("VirtIO Device ID: VIRTIO_ID_RPROC_SERIAL (%lu)", (unsigned long)VIRTIO_ID_RPROC_SERIAL);
	LOG_INF("Number of VRINGs: %d", VRING_COUNT);
	LOG_INF("Initial VRING addresses (before Linux allocation):");
	LOG_INF("  RX: 0x%08lX (FW_RSC_ADDR_ANY = magic value)", (unsigned long)VRING_RX_ADDRESS);
	LOG_INF("  TX: 0x%08lX (FW_RSC_ADDR_ANY = magic value)", (unsigned long)VRING_TX_ADDRESS);
	LOG_INF("Linux will allocate actual addresses and update resource table");

	printk("\n");
	LOG_INF("Waiting for Linux to allocate VRING memory...");

	/* Wait for Linux to allocate VRING addresses */
	while (!rsc_table_vrings_allocated() && timeout > 0) {
		k_sleep(K_MSEC(100));
		timeout--;
	}

	if (!rsc_table_vrings_allocated()) {
		LOG_ERR("Timeout waiting for Linux VRING allocation");
		LOG_ERR("RX addr: 0x%08lX, TX addr: 0x%08lX",
		        (unsigned long)rsc_table_get_vring_rx_addr(),
		        (unsigned long)rsc_table_get_vring_tx_addr());
		LOG_WRN("This is normal if Linux hasn't loaded the firmware yet");
	} else {
		/* Get the addresses Linux allocated */
		vring_rx_addr = rsc_table_get_vring_rx_addr();
		vring_tx_addr = rsc_table_get_vring_tx_addr();

		printk("\n");
		LOG_INF("===========================================");
		LOG_INF("Linux allocated VRINGs:");
		LOG_INF("  RX VRING: 0x%08lX", (unsigned long)vring_rx_addr);
		LOG_INF("  TX VRING: 0x%08lX", (unsigned long)vring_tx_addr);
		LOG_INF("===========================================");
		printk("\n");

		LOG_INF("VirtIO Serial device ready!");
		LOG_INF("To complete: Implement vring initialization and callbacks");
	}

	/* Main loop */
	while (1) {
		k_sleep(K_SECONDS(10));
		LOG_DBG("Still running - waiting for full implementation...");
	}

	return 0;
}
```

## src/main_simple.c
```c
/*
 * Copyright (c) 2024 Your Name
 *
 * SPDX-License-Identifier: Apache-2.0
 *
 * Simplified VirtIO Serial implementation for TI AM62x M4 core
 * using Zephyr's IPC service with static VRINGs
 *
 * This version is more practical and uses Zephyr's built-in infrastructure
 */

#include <zephyr/kernel.h>
#include <zephyr/sys/printk.h>
#include <zephyr/logging/log.h>

#include <openamp/open_amp.h>
#include "resource_table.h"

LOG_MODULE_REGISTER(virtio_serial, LOG_LEVEL_DBG);

/* Shared memory buffers for VRINGs (must be in shared memory region) */
static uint8_t vring_rx_buffer[VRING_SIZE * 512] __aligned(VRING_ALIGNMENT);
static uint8_t vring_tx_buffer[VRING_SIZE * 512] __aligned(VRING_ALIGNMENT);

/* VirtIO structures */
struct virtio_device vdev;
struct virtqueue *vq_rx;
struct virtqueue *vq_tx;
struct metal_io_region io_region;

/**
 * Callback when data is received from Linux
 */
static void rx_callback(struct virtqueue *vq)
{
	void *buffer;
	uint32_t len;
	int ret;

	LOG_INF("=== DATA RECEIVED FROM LINUX ===");

	/* Process all available buffers */
	while ((buffer = virtqueue_get_buffer(vq, &len)) != NULL) {
		if (len > 0) {
			LOG_INF("Received %u bytes from Linux", len);

			/* Log the received data */
			LOG_HEXDUMP_INF(buffer, MIN(len, 64), "Data:");

			/* Return buffer to the vring for reuse */
			ret = virtqueue_add_buffer(vq, buffer, 0, len, buffer);
			if (ret < 0) {
				LOG_ERR("Failed to return buffer: %d", ret);
			}
		}
	}

	/* Notify Linux that we've processed the buffers */
	virtqueue_kick(vq);
}

/**
 * Callback when Linux has consumed our TX data
 */
static void tx_callback(struct virtqueue *vq)
{
	void *buffer;
	uint32_t len;

	LOG_DBG("TX callback - Linux consumed data");

	/* Reclaim sent buffers */
	while ((buffer = virtqueue_get_buffer(vq, &len)) != NULL) {
		LOG_DBG("TX buffer returned: %p", buffer);
		/* Free or reuse buffer */
	}
}

/**
 * VirtIO notify function - trigger interrupt to Linux
 * On AM62x, this should use the mailbox subsystem
 */
static int notify_func(struct virtqueue *vq)
{
	LOG_DBG("Notify Linux about vring update");

	/* TODO: On real hardware, trigger mailbox interrupt here
	 * Example:
	 * struct device *mbox = device_get_binding("MAILBOX_0");
	 * mailbox_send(mbox, MAILBOX_CHANNEL, NULL);
	 */

	return 0;
}

/**
 * Main function
 */
int main(void)
{
	int ret;

	printk("\n");
	printk("===============================================\n");
	printk("  VirtIO Serial - Simple Implementation       \n");
	printk("  TI AM62x M4 Core with Zephyr RTOS            \n");
	printk("===============================================\n");
	printk("\n");

	LOG_INF("VirtIO Serial Device starting...");
	LOG_INF("Resource table: %p", &resource_table);
	LOG_INF("Device ID: VIRTIO_ID_RPROC_SERIAL (%d)", VIRTIO_ID_RPROC_SERIAL);

	/* Initialize libmetal */
	struct metal_init_params metal_params = METAL_INIT_DEFAULTS;
	ret = metal_init(&metal_params);
	if (ret) {
		LOG_ERR("Failed to init metal: %d", ret);
		return ret;
	}
	LOG_INF("LibMetal initialized");

	/* Setup IO region for shared memory */
	metal_io_init(&io_region, vring_rx_buffer,
	              (metal_phys_addr_t *)vring_rx_buffer,
	              sizeof(vring_rx_buffer) + sizeof(vring_tx_buffer),
	              (unsigned)-1, 0, NULL);

	/* Initialize VirtIO device */
	vdev.role = VIRTIO_DEV_DEVICE;  /* We are the device, Linux is driver */
	vdev.func = (void *)notify_func;

	/* Create RX virtqueue (Linux to M4) */
	vq_rx = virtqueue_create(&vdev, 0, "rx",
	                         VRING_SIZE, VRING_ALIGNMENT,
	                         vring_rx_buffer, &io_region,
	                         rx_callback);
	if (!vq_rx) {
		LOG_ERR("Failed to create RX virtqueue");
		return -ENOMEM;
	}
	LOG_INF("RX virtqueue created");

	/* Create TX virtqueue (M4 to Linux) */
	vq_tx = virtqueue_create(&vdev, 1, "tx",
	                         VRING_SIZE, VRING_ALIGNMENT,
	                         vring_tx_buffer, &io_region,
	                         tx_callback);
	if (!vq_tx) {
		LOG_ERR("Failed to create TX virtqueue");
		return -ENOMEM;
	}
	LOG_INF("TX virtqueue created");

	printk("\n");
	LOG_INF("===========================================");
	LOG_INF("  VirtIO Serial Device READY");
	LOG_INF("  Waiting for Linux to send data...");
	LOG_INF("===========================================");
	printk("\n");

	LOG_INF("Instructions:");
	LOG_INF("1. Boot Linux on A53 core");
	LOG_INF("2. Load this M4 firmware via remoteproc");
	LOG_INF("3. Linux will create /dev/vportXpY");
	LOG_INF("4. Write to device: echo 'test' > /dev/vportXpY");
	LOG_INF("5. Watch this console for received data!");

	/* Main loop - handle interrupts */
	while (1) {
		/* In a real implementation, this would be interrupt-driven
		 * For now, we can poll or just sleep
		 */
		k_sleep(K_SECONDS(10));
		LOG_DBG("Alive - waiting for data...");
	}

	return 0;
}
```

## src/resource_table.c
```c
/*
 * Copyright (c) 2024 Your Name
 *
 * SPDX-License-Identifier: Apache-2.0
 */

#include "resource_table.h"

/*
 * Resource table definition for Linux remoteproc
 *
 * This table is placed in a special section (.resource_table) that Linux
 * remoteproc can discover. It describes the virtio serial device and its
 * two vrings (RX and TX).
 *
 * IMPORTANT: The VRING addresses are initialized with FW_RSC_ADDR_ANY (0xFFFFFFFF).
 * This tells Linux remoteproc to allocate the VRING memory dynamically.
 * After Linux loads the firmware and allocates memory, it will update these
 * addresses in the resource table. The M4 can then read the actual addresses
 * from this table.
 */
struct fw_resource_table __attribute__((section(".resource_table"))) resource_table = {
	/* Resource table header */
	.table_hdr = {
		.ver = 1,
		.num = RSC_TABLE_NUM_ENTRY,
		.reserved = {0, 0},
	},

	/* Offsets to resource entries */
	.offset = {
		offsetof(struct fw_resource_table, vdev),
	},

	/* VirtIO device entry - RPROC_SERIAL */
	.vdev = {
		.type = RSC_VDEV,
		.id = VIRTIO_ID_RPROC_SERIAL,  /* Device ID 11 for rproc_serial */
		.notifyid = VDEV_ID,
		.dfeatures = RPMSG_IPU_C0_FEATURES,
		.gfeatures = 0,
		.config_len = 0,
		.status = 0,
		.num_of_vrings = VRING_COUNT,
		.reserved = {0, 0},
	},

	/* VRING 0 - Linux RX (M4 TX) - First vring allocated by Linux */
	.vring0 = {
		.da = VRING_TX_ADDRESS,  /* M4 sends data here */
		.align = VRING_ALIGNMENT,
		.num = VRING_SIZE,
		.notifyid = 0,
		.reserved = 0,
	},

	/* VRING 1 - Linux TX (M4 RX) - Second vring allocated by Linux */
	.vring1 = {
		.da = VRING_RX_ADDRESS,  /* M4 receives data from here */
		.align = VRING_ALIGNMENT,
		.num = VRING_SIZE,
		.notifyid = 1,
		.reserved = 0,
	},
};

/*
 * Helper function to get the M4 RX VRING address after Linux has allocated it
 * Returns vring1.da because Linux allocates vring1 for its TX (M4's RX)
 */
uint32_t rsc_table_get_vring_rx_addr(void)
{
	return resource_table.vring1.da;
}

/*
 * Helper function to get the M4 TX VRING address after Linux has allocated it
 * Returns vring0.da because Linux allocates vring0 for its RX (M4's TX)
 */
uint32_t rsc_table_get_vring_tx_addr(void)
{
	return resource_table.vring0.da;
}

/*
 * Check if Linux has allocated the VRING addresses
 * Returns true if addresses are valid (not FW_RSC_ADDR_ANY)
 */
bool rsc_table_vrings_allocated(void)
{
	return (resource_table.vring0.da != FW_RSC_ADDR_ANY &&
	        resource_table.vring1.da != FW_RSC_ADDR_ANY);
}
```

## src/resource_table.h
```c
/*
 * Copyright (c) 2024 Your Name
 *
 * SPDX-License-Identifier: Apache-2.0
 */

#ifndef RESOURCE_TABLE_H_
#define RESOURCE_TABLE_H_

#include <stddef.h>
#include <stdbool.h>
#include <stdint.h>
#include <openamp/open_amp.h>

/* VirtIO rpmsg device ID - for rproc_serial */
#define VDEV_ID                    0xFF
#define VRING_COUNT                2

/* VRING IDs (notifyid) */
#define VRING0_ID                  0
#define VRING1_ID                  1

/*
 * VRING addresses: Use magic value FW_RSC_ADDR_ANY to tell Linux
 * remoteproc to allocate the VRING memory dynamically.
 * Linux will fill in the actual addresses after allocation.
 */
#define FW_RSC_ADDR_ANY            0xFFFFFFFF
#define VRING_RX_ADDRESS           FW_RSC_ADDR_ANY
#define VRING_TX_ADDRESS           FW_RSC_ADDR_ANY
#define VRING_ALIGNMENT            0x1000  /* 4KB alignment for safety */
#define VRING_SIZE                 16  /* Number of descriptors in each ring */

#define RPMSG_IPU_C0_FEATURES      1

/* Resource table entries */
#define RSC_TABLE_NUM_ENTRY        1

/* VirtIO device features */
#ifndef VIRTIO_ID_RPROC_SERIAL
#define VIRTIO_ID_RPROC_SERIAL     11
#endif

struct fw_resource_table {
	struct resource_table table_hdr;
	uint32_t offset[RSC_TABLE_NUM_ENTRY];
	struct fw_rsc_vdev vdev;
	struct fw_rsc_vdev_vring vring0;
	struct fw_rsc_vdev_vring vring1;
} __packed;

/*
 * Resource table - will be modified by Linux remoteproc
 * Linux fills in the VRING addresses after allocation
 */
extern struct fw_resource_table resource_table;

/*
 * Helper functions to read Linux-allocated VRING addresses
 */
uint32_t rsc_table_get_vring_rx_addr(void);
uint32_t rsc_table_get_vring_tx_addr(void);
bool rsc_table_vrings_allocated(void);

#endif /* RESOURCE_TABLE_H_ */
```
